## CMakeLists.txt
```
#
# Copyright (c) 2019 Nordic Semiconductor ASA
#
# SPDX-License-Identifier: LicenseRef-BSD-5-Clause-Nordic
#
cmake_minimum_required(VERSION 3.13.1)

find_package(Zephyr REQUIRED HINTS $ENV{ZEPHYR_BASE})
project(NONE)

zephyr_include_directories(
  kernel/include
  ${ARCH_DIR}/${ARCH}/include
)

zephyr_library_sources(src/main.c)
zephyr_sources(src/secure_services.c)
```

## prj.conf
```kconfig
CONFIG_IS_SPM=y
CONFIG_SPM_SECURE_SERVICES=y
CONFIG_SPM_SERVICE_READ=y
CONFIG_SPM_SERVICE_RNG=y
CONFIG_FW_INFO=y
CONFIG_GPIO=n
CONFIG_ARM_FIRMWARE_HAS_SECURE_ENTRY_FUNCS=y

#crypto
CONFIG_NORDIC_SECURITY_BACKEND=y
CONFIG_CC3XX_BACKEND=y
CONFIG_MBEDTLS_VANILLA_BACKEND=n
CONFIG_OBERON_BACKEND=n

CONFIG_MAIN_STACK_SIZE=4096
```

## src/main.c
```c
/*
 * Copyright (c) 2018 Nordic Semiconductor ASA.
 *
 * SPDX-License-Identifier: LicenseRef-BSD-5-Clause-Nordic
 */

#include <spm.h>
#include <cortex_m/tz.h>
#include <sys/printk.h>
#include <stdio.h>

#include "secure_services.h"

void main(void)
{
	spm_config();
	spm_jump();
}
```

## src/secure_services.c
```c
#include <errno.h>
#include <cortex_m/tz.h>
#include <autoconf.h>
#include "secure_services.h"

#include <zephyr.h>
#include <sys/printk.h>
#include <string.h>
#include "nrf_cc3xx_platform.h"
#include "nrf_cc3xx_platform_kmu.h"
#include "mbedtls/cc3xx_kmu.h"
#include "mbedtls/aes.h"
#include "mbedtls/ctr_drbg.h"

__TZ_NONSECURE_ENTRY_FUNC
int spm_store_key_in_kmu_nse(uint32_t slot_id, uint32_t addr, uint32_t permission, uint8_t *key)
{
    int ret;

    ret = nrf_cc3xx_platform_kmu_write_key_slot(
        slot_id,
        addr,
        permission,
        key);
    return ret;
}

__TZ_NONSECURE_ENTRY_FUNC
int spm_encrypt_using_keyslot_nse(uint8_t slot_id, uint32_t keybits, uint8_t *plaintext, uint8_t *encrypted)
{

    mbedtls_aes_context ctx = {0};
    int ret;
    mbedtls_aes_init(&ctx);
    ret = mbedtls_aes_setkey_enc_shadow_key(&ctx, slot_id, keybits);
    if (ret != 0)
    {
        return -1;
    }
    mbedtls_aes_encrypt(&ctx, plaintext, encrypted);
    return 0;
}

__TZ_NONSECURE_ENTRY_FUNC
int spm_decrypt_using_keyslot_nse(uint8_t slot_id, uint32_t keybits, uint8_t *encrypted, uint8_t *plaintext)
{
    mbedtls_aes_context ctx = {0};
    int ret;

    // Reinitialize context.
    mbedtls_aes_init(&ctx);

    // Set to use direct shadow key for decryption.
    ret = mbedtls_aes_setkey_dec_shadow_key(&ctx, slot_id, keybits);
    if (ret != 0)
    {
        return -1;
    }

    mbedtls_aes_decrypt(&ctx, encrypted, plaintext);
    return 0;
}
/*
__TZ_NONSECURE_ENTRY_FUNC
uint64_t spm_request_UID()
{
    uint64_t uid = 0;
}*/
/*
__TZ_NONSECURE_ENTRY_FUNC
int spm_request_random_number_nse(uint8_t *output, size_t len, size_t *olen)
{
    int err;

    if (len != MBEDTLS_ENTROPY_MAX_GATHER)
    {
        return -EINVAL;
    }

    err = mbedtls_hardware_poll(NULL, output, len, olen);
    return err;
}
*/
```

## src/spm_internal.h
```c
#ifndef SPM_INTERNAL_H__
#define SPM_INTERNAL_H__

#include <zephyr.h>
#include <nrfx.h>
#include <misc/util.h>

/*
#define NRF_NSE(ret, name, ...)  \
    ret name##_nse(__VA_ARGS__); \
    TZ_THREAD_SAFE_NONSECURE_ENTRY_FUNC(name, ret, name##_nse, __VA_ARGS__)
*/
NRF_NSE(int, spm_store_key_in_kmu, uint32_t slot_id, uint32_t addr, uint32_t permission, uint8_t *key);

NRF_NSE(int, spm_encrypt_using_keyslot, uint8_t slot_id, uint32_t keybits, uint8_t *plaintext, uint8_t *encrypted);

NRF_NSE(int, spm_decrypt_using_keyslot, uint8_t slot_id, uint32_t keybits, uint8_t *encrypted, uint8_t *plaintext);
#endif /* SPM_INTERNAL_H__ */
```
