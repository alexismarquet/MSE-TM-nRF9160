## CMakeLists.txt
```
#
# Copyright (c) 2018 Nordic Semiconductor
#
# SPDX-License-Identifier: LicenseRef-BSD-5-Clause-Nordic
#

cmake_minimum_required(VERSION 3.13.1)

list(APPEND ZEPHYR_EXTRA_MODULES
   ${CMAKE_CURRENT_SOURCE_DIR}/../spm_module)

find_package(Zephyr REQUIRED HINTS $ENV{ZEPHYR_BASE})
project(NONE)

zephyr_include_directories(
  kernel/include
  ${ARCH_DIR}/${ARCH}/include
)
# NORDIC SDK APP START
target_sources(app PRIVATE src/main.c)
target_sources(app PRIVATE src/measures.c)
zephyr_sources(src/secure_services_ns.c)
  # NORDIC SDK APP END
zephyr_include_directories(src)
```

## Kconfig
```
#
# Copyright (c) 2020 Nordic Semiconductor ASA
#
# SPDX-License-Identifier: LicenseRef-BSD-5-Clause-Nordic
#

menu "AWS IoT Sample Settings"

config APP_VERSION
	string "Application version"
	default "v0.1.0"

config PUBLICATION_INTERVAL_SECONDS
	int "Interval in seconds that the sample will publish data"
	default 60

config CONNECTION_RETRY_TIMEOUT_SECONDS
	int "Number of seconds between each AWS IoT connection retry"
	default 5

endmenu

menu "Zephyr Kernel"
source "Kconfig.zephyr"
endmenu
```

## prj.conf
```kconfig
# General config
CONFIG_NCS_SAMPLES_DEFAULTS=y
CONFIG_REBOOT=y

CONFIG_SPM_BUILD_STRATEGY_SKIP_BUILD=y
CONFIG_SPM=y
CONFIG_ARM_FIRMWARE_USES_SECURE_ENTRY_FUNCS=y
CONFIG_ARM_ENTRY_VENEERS_LIB_NAME="spm/libspmsecureentries.a"


CONFIG_HW_STACK_PROTECTION=y
CONFIG_STACK_USAGE=y
CONFIG_DEBUG_INFO=y
CONFIG_THREAD_NAME=y
#CONFIG_LOG_STRDUP_MAX_STRING=256
#CONFIG_LOG_STRDUP_BUF_COUNT=16
#CONFIG_LOG_BACKEND_RTT=y # Cannot select, because shell uses it.
CONFIG_NO_OPTIMIZATIONS=y
CONFIG_THREAD_ANALYZER=y
CONFIG_THREAD_ANALYZER_AUTO=y
CONFIG_THREAD_ANALYZER_AUTO_INTERVAL=60

CONFIG_CONSOLE=y
CONFIG_RTT_CONSOLE=y
CONFIG_USE_SEGGER_RTT=y
CONFIG_SEGGER_SYSTEMVIEW=y
CONFIG_SERIAL=y
CONFIG_LOG=y
CONFIG_LOG_MINIMAL=n
CONFIG_LOG_IMMEDIATE=y
CONFIG_LOG_IMMEDIATE_CLEAN_OUTPUT=y
CONFIG_LOG_BACKEND_RTT_OUTPUT_BUFFER_SIZE=512
CONFIG_NO_OPTIMIZATIONS=n


CONFIG_NORDIC_SECURITY_BACKEND=y
CONFIG_MBEDTLS=y
CONFIG_MBEDTLS_LIBRARY=y
CONFIG_ENTROPY_GENERATOR=y
#CONFIG_MBEDTLS_ENABLE_HEAP=y
#CONFIG_MBEDTLS_HEAP_SIZE=65536
CONFIG_MBEDTLS_CTR_DRBG_C=y
CONFIG_MBEDTLS_INSTALL_PATH="DUMMY"
CONFIG_SPEED_OPTIMIZATIONS=y


CONFIG_SPM_BOOT_SILENTLY=y

CONFIG_SPM_SECURE_SERVICES=y


# Heap and stacks
CONFIG_HEAP_MEM_POOL_SIZE=32768
CONFIG_SYSTEM_WORKQUEUE_STACK_SIZE=16384
CONFIG_DATE_TIME_THREAD_SIZE=2048
CONFIG_MAIN_STACK_SIZE=16384
CONFIG_THREAD_ANALYZER_AUTO_STACK_SIZE=2048
CONFIG_AWS_IOT_MQTT_RX_TX_BUFFER_LEN=8192
CONFIG_AWS_IOT_MQTT_PAYLOAD_BUFFER_LEN=8192

# Network
CONFIG_NETWORKING=y
CONFIG_NET_NATIVE=n

# LTE link control
CONFIG_LTE_LINK_CONTROL=y
CONFIG_LTE_NETWORK_MODE_LTE_M=y
CONFIG_LTE_AUTO_INIT_AND_CONNECT=n


# BSD library
CONFIG_BSD_LIBRARY=y
CONFIG_BSD_LIBRARY_SYS_INIT=n

# AT Host
CONFIG_UART_INTERRUPT_DRIVEN=y
CONFIG_AT_HOST_LIBRARY=y


# AWS IoT library
CONFIG_AWS_IOT=y
CONFIG_AWS_IOT_CLIENT_ID_STATIC="..."
CONFIG_AWS_IOT_BROKER_HOST_NAME="..."
CONFIG_AWS_IOT_SEC_TAG=201
CONFIG_AWS_IOT_APP_SUBSCRIPTION_LIST_COUNT=1
CONFIG_AWS_IOT_CONNECTION_POLL_THREAD=y
CONFIG_CONNECTION_RETRY_TIMEOUT_SECONDS=30
CONFIG_MQTT_CLEAN_SESSION=y
#CONFIG_NET_IPV6=y
#CONFIG_AWS_IOT_IPV6=y
#CONFIG_NET_CONFIG_NEED_IPV6=y
#CONFIG_LTE_PDP_CMD=y
#CONFIG_LTE_PDP_CONTEXT="0,\"IPv4v6\",\"swisscom-test.m2m.ch\""
#CONFIG_DATE_TIME_IPV6=y


# Date Time library
CONFIG_DATE_TIME=y
CONFIG_DATE_TIME_MODEM=y

# Modem information
CONFIG_MODEM_INFO=y

# CJSON
CONFIG_CJSON_LIB=y

# NEWLIB C
CONFIG_NEWLIB_LIBC=y
CONFIG_NEWLIB_LIBC_FLOAT_PRINTF=y
CONFIG_NEWLIB_LIBC_NANO=n

CONFIG_MQTT_LOG_LEVEL_DBG=n
CONFIG_AWS_IOT_LOG_LEVEL_DBG=n
CONFIG_MQTT_KEEPALIVE=60
CONFIG_NET_LOG=n

CONFIG_BOARD_SELECT_SIM_EXTERNAL=y

CONFIG_DEBUG_OPTIMIZATIONS=y

CONFIG_GPIO=y
```

## src/main.c
```c
#include <stdio.h>
#include <zephyr.h>
#include <sys/printk.h>
#include "secure_services.h"
#include <logging/log.h>

#include <stdlib.h>
#if defined(CONFIG_BSD_LIB)
#include <modem/lte_lc.h>
#include <modem/bsdlib.h>
#include <modem/at_cmd.h>
#include <modem/at_notif.h>
#include <modem/modem_info.h>
#include <bsd.h>
#endif
#include <net/aws_iot.h>
#include <power/reboot.h>
#include <date_time.h>
#include <cJSON.h>
#include <cJSON_os.h>
#include "measures.h"
#include <date_time.h>

#include <drivers/gpio.h>

#define RED_LED_PIN DT_GPIO_PIN(DT_NODELABEL(red_led), gpios)
#define GREEN_LED_PIN DT_GPIO_PIN(DT_NODELABEL(green_led), gpios)
#define BLUE_LED_PIN DT_GPIO_PIN(DT_NODELABEL(blue_led), gpios)

#define BUTTON_NODE DT_NODELABEL(button0)
#define BUTTON_GPIO_LABEL DT_GPIO_LABEL(BUTTON_NODE, gpios)
#define BUTTON_GPIO_PIN DT_GPIO_PIN(BUTTON_NODE, gpios)
#define BUTTON_GPIO_FLAGS GPIO_INPUT | DT_GPIO_FLAGS(BUTTON_NODE, gpios)

#define LED_ON 0
#define LED_OFF !LED_ON
static const struct device *gpio_dev;
static struct gpio_callback gpio_cb;
bool button_pressed = false;

LOG_MODULE_REGISTER(main, LOG_LEVEL_DBG);

char custom_topic[75] = "";
uint64_t get_uid();

uint32_t randint(uint32_t a, uint32_t b);

BUILD_ASSERT(!IS_ENABLED(CONFIG_LTE_AUTO_INIT_AND_CONNECT),
             "This sample does not support LTE auto-init and connect");

#define APP_TOPICS_COUNT CONFIG_AWS_IOT_APP_SUBSCRIPTION_LIST_COUNT
#define DATE_TIME_TIMEOUT_S 15

static struct k_delayed_work connect_work;

static struct k_delayed_work send_measure_work;

K_SEM_DEFINE(lte_connected, 0, 1);
K_SEM_DEFINE(date_time_obtained, 0, 1);

void publish(char *topic, char *payload)
{
    int err;
    struct aws_iot_data tx_data = {
        .qos = MQTT_QOS_1_AT_LEAST_ONCE,
        .topic.type = AWS_IOT_SHADOW_TOPIC_UNKNOWN,
        .topic.str = topic,
        .topic.len = strlen(topic),
        .ptr = payload,
        .len = strlen(payload)};

    // dont send if client is not live
    LOG_INF("publish: %s/%s", tx_data.topic.str, tx_data.ptr);
    err = aws_iot_send(&tx_data);

    if (err)
    {
        //   if (err != -EINPROGRESS)
        //   {
        LOG_ERR("mqtt_publish, error: %d", err);
        //   }
    }
}

size_t pad16(uint8_t *buf, size_t lenIn)
{
    if (lenIn % 16)
    {
        for (int i = 0; i < 16 - (lenIn % 16); i++)
        {
            buf[lenIn + i] = 0;
        }
        return lenIn + (16 - (lenIn % 16));
    }
    else
    {
        return lenIn;
    }
}

static void connect_work_fn(struct k_work *work)
{
    int err;

    err = aws_iot_connect(NULL);
    if (err)
    {
        LOG_ERR("aws_iot_connect, error: %d", err);
    }

    LOG_WRN("Next connection retry in %d seconds",
            CONFIG_CONNECTION_RETRY_TIMEOUT_SECONDS);

    k_delayed_work_submit(&connect_work,
                          K_SECONDS(CONFIG_CONNECTION_RETRY_TIMEOUT_SECONDS));
}
void deserialize(uint8_t *inBuffer, size_t inStrLen, uint8_t *outBuffer)
{
    for (int i = 0; i < inStrLen / 2; i++)
    {
        uint8_t tmp = 0;
        uint8_t byte;
        byte = inBuffer[(2 * i)];
        if (byte >= '0' && byte <= '9')
            byte = byte - '0';
        else if (byte >= 'a' && byte <= 'f')
            byte = byte - 'a' + 10;
        else if (byte >= 'A' && byte <= 'F')
            byte = byte - 'A' + 10;
        tmp |= byte << 4;

        byte = inBuffer[(2 * i) + 1];
        if (byte >= '0' && byte <= '9')
            byte = byte - '0';
        else if (byte >= 'a' && byte <= 'f')
            byte = byte - 'a' + 10;
        else if (byte >= 'A' && byte <= 'F')
            byte = byte - 'A' + 10;
        tmp |= byte & 0xF;
        outBuffer[i] = tmp;
    }
}

static void print_received_data(const char *buf, const char *topic,
                                size_t topic_len)
{
    cJSON *root_obj = NULL;

    root_obj = cJSON_Parse(buf);
    if (root_obj == NULL)
    {
        LOG_ERR("cJSON Parse failure");
        return;
    }
    uint32_t n_payloads = cJSON_GetArraySize(root_obj);
    LOG_DBG("received %d payloads", n_payloads);

    measure_t measures[10];

    for (int i = 0; i < n_payloads; i++)
    {
        //uint8_t buf[256];
        cJSON *n = cJSON_GetArrayItem(root_obj, i);
        if (n == NULL)
        {
            LOG_ERR("Failed to get item at index %d", i);
        }
        cJSON *entry = cJSON_GetObjectItemCaseSensitive(n, "entry");
        if (entry == NULL)
        {
            LOG_ERR("received misformed json");
        }
        if (cJSON_IsString(entry) && (entry->valuestring != NULL))
        {
            //LOG_DBG("treating %s", entry->valuestring);
            uint8_t buf[128];
            size_t len = strlen(entry->valuestring);
            deserialize(entry->valuestring, len, buf);
            uint8_t plain[128];
            decrypt(buf, plain, len / 2);
            unpack(plain, &measures[i]);
            LOG_INF("decrypted ");
            printMUID(&measures[i]);
        }
    }
    // shuffle measures
    shuffle(measures, n_payloads);

    for (int i = 0; i < n_payloads; i++)
    {
        char *message = measure_as_json(&measures[i]);
        if (message)
        {
            publish("measures", message);
            LOG_WRN("str: %s", message);
            cJSON_free(message);
        }
        else
        {
            LOG_ERR("failed to print json unformatted");
        }
    }
    cJSON_Delete(root_obj);
    gpio_pin_set(gpio_dev, GREEN_LED_PIN, LED_OFF);
}

void aws_iot_event_handler(const struct aws_iot_evt *const evt)
{
    switch (evt->type)
    {
    case AWS_IOT_EVT_CONNECTING:
        LOG_INF("AWS_IOT_EVT_CONNECTING");
        if (k_delayed_work_pending(&send_measure_work))
        {
            k_delayed_work_cancel(&send_measure_work);
        }
        break;
    case AWS_IOT_EVT_CONNECTED:
        LOG_INF("AWS_IOT_EVT_CONNECTED");

        if (evt->data.persistent_session)
        {
            LOG_INF("Persistent session enabled");
        }

#if defined(CONFIG_BSD_LIBRARY)
        int err = lte_lc_psm_req(true);
        if (err)
        {
            LOG_ERR("Requesting PSM failed, error: %d", err);
        }
#endif
        break;
    case AWS_IOT_EVT_READY:
        LOG_INF("AWS_IOT_EVT_READY");
        gpio_pin_set(gpio_dev, RED_LED_PIN, LED_OFF);
        k_delayed_work_submit(&send_measure_work, K_MSEC(5000));

        break;
    case AWS_IOT_EVT_DISCONNECTED:
        gpio_pin_set(gpio_dev, RED_LED_PIN, LED_ON);
        LOG_INF("AWS_IOT_EVT_DISCONNECTED");
        if (k_delayed_work_pending(&send_measure_work))
        {
            k_delayed_work_cancel(&send_measure_work);
        }

        if (k_delayed_work_pending(&connect_work))
        {
            break;
        }

        k_delayed_work_submit(&connect_work, K_NO_WAIT);
        break;
    case AWS_IOT_EVT_DATA_RECEIVED:
        LOG_INF("AWS_IOT_EVT_DATA_RECEIVED");
        print_received_data(evt->data.msg.ptr, evt->data.msg.topic.str,
                            evt->data.msg.topic.len);
        break;

    case AWS_IOT_EVT_ERROR:
        LOG_ERR("AWS_IOT_EVT_ERROR, %d", evt->data.err);
        break;
    default:
        LOG_WRN("Unknown AWS IoT event type: %d", evt->type);
        break;
    }
}

static void work_init(void)
{
    //k_delayed_work_init(&shadow_update_work, shadow_update_work_fn);
    k_delayed_work_init(&connect_work, connect_work_fn);
    //k_delayed_work_init(&shadow_update_version_work,
    //                    shadow_update_version_work_fn);
}

#if defined(CONFIG_BSD_LIBRARY)
static void lte_handler(const struct lte_lc_evt *const evt)
{
    switch (evt->type)
    {
    case LTE_LC_EVT_NW_REG_STATUS:
        if ((evt->nw_reg_status != LTE_LC_NW_REG_REGISTERED_HOME) &&
            (evt->nw_reg_status != LTE_LC_NW_REG_REGISTERED_ROAMING))
        {
            break;
        }

        LOG_INF("Network registration status: %s",
                evt->nw_reg_status == LTE_LC_NW_REG_REGISTERED_HOME ? "Connected - home network" : "Connected - roaming");

        k_sem_give(&lte_connected);
        break;
    case LTE_LC_EVT_PSM_UPDATE:
        LOG_INF("PSM parameter update: TAU: %d, Active time: %d",
                evt->psm_cfg.tau, evt->psm_cfg.active_time);
        break;
    case LTE_LC_EVT_EDRX_UPDATE:
    {
        char log_buf[60];
        ssize_t len;

        len = snprintf(log_buf, sizeof(log_buf),
                       "eDRX parameter update: eDRX: %f, PTW: %f",
                       evt->edrx_cfg.edrx, evt->edrx_cfg.ptw);
        if (len > 0)
        {
            LOG_INF("%s", log_buf);
        }
        break;
    }
    case LTE_LC_EVT_RRC_UPDATE:
        LOG_INF("RRC mode: %s",
                evt->rrc_mode == LTE_LC_RRC_MODE_CONNECTED ? "Connected" : "Idle");
        break;
    case LTE_LC_EVT_CELL_UPDATE:
        LOG_INF("LTE cell changed: Cell ID: %d, Tracking area: %d",
                evt->cell.id, evt->cell.tac);
        break;
    default:
        break;
    }
}

static void modem_configure(void)
{
    int err;

    if (IS_ENABLED(CONFIG_LTE_AUTO_INIT_AND_CONNECT))
    {
        /* Do nothing, modem is already configured and LTE connected. */
    }
    else
    {
        err = lte_lc_init_and_connect_async(lte_handler);
        if (err)
        {
            LOG_ERR("Modem could not be configured, error: %d",
                    err);
            return;
        }
    }
}

static void at_configure(void)
{
    int err;

    err = at_notif_init();
    __ASSERT(err == 0, "AT Notify could not be initialized.");
    err = at_cmd_init();
    __ASSERT(err == 0, "AT CMD could not be established.");
}
#endif

static int app_topics_subscribe(void)
{
    int err;
    uint64_t uid = get_uid();
    sprintf(custom_topic, "getPool%08" PRIx64, uid);
    LOG_INF("subscribing to %s", custom_topic);
    const struct aws_iot_topic_data topics_list[APP_TOPICS_COUNT] = {
        [0].str = custom_topic,
        [0].len = strlen(custom_topic)};

    err = aws_iot_subscription_topics_add(topics_list,
                                          ARRAY_SIZE(topics_list));
    if (err)
    {
        LOG_ERR("aws_iot_subscription_topics_add, error: %d", err);
    }

    return err;
}
static void date_time_event_handler(const struct date_time_evt *evt)
{
    switch (evt->type)
    {
    case DATE_TIME_OBTAINED_MODEM:
        LOG_INF("DATE_TIME_OBTAINED_MODEM");
        break;
    case DATE_TIME_OBTAINED_NTP:
        LOG_INF("DATE_TIME_OBTAINED_NTP");
        break;
    case DATE_TIME_OBTAINED_EXT:
        LOG_INF("DATE_TIME_OBTAINED_EXT");
        break;
    case DATE_TIME_NOT_OBTAINED:
        LOG_WRN("DATE_TIME_NOT_OBTAINED");
        break;
    default:
        break;
    }

    /** Do not depend on obtained time, continue upon any event from the
 *  date time library.
 */
    k_sem_give(&date_time_obtained);
}

uint32_t randint(uint32_t a, uint32_t b)
{
    uint64_t rand[18];
    size_t oLen = 0;
    spm_request_random_number((uint8_t *)rand, sizeof(rand), &oLen);
    return (rand[0] % (b - a)) + a;
}
uint64_t get_uid()
{
    // get Device UID
    uint64_t uid = 0;
    spm_request_read(&uid, 0x00FF0000 + 0x204, sizeof(uid));
    return uid;
}
void send_measure()
{
    gpio_pin_set(gpio_dev, BLUE_LED_PIN, LED_ON);
    int err;
    int16_t temperature_data;

    // generate measure
    measure_t m;
    memset(&m, 0, sizeof(m));
    GenerateMUID(&m, get_uid());
    // add GPS location

    // dummy values
    err = modem_info_short_get(MODEM_INFO_TEMP, &temperature_data);
    m.data = temperature_data;

    // encrypt measure
    uint8_t buf[128];
    uint8_t encrypted[128];
    size_t len_packed = pack(buf, &m);
    size_t len_padded = pad16(buf, len_packed);
    uint8_t hex_buf[256];

    encrypt(buf, encrypted, len_padded);

    for (int i = 0; i < len_padded; i++)
    {
        sprintf(&hex_buf[i * 2], "%02X", encrypted[i]);
    }

    // send payload
    printMUID(&m);

    publish("addToPool", hex_buf);
    char *message = measure_as_json(&m);
    if (message)
    {
        publish("cheater", message);
        cJSON_free(message);
    }
    else
    {
        LOG_ERR("failed to allocate memory for json message");
    }

    // with 10% chance, ask for payload pool
    int chance = randint(0, 10000);
    LOG_INF("chance = %d", chance);
    if (chance < 1500)
    {
        LOG_WRN("asking for pool");
        {
            uint64_t uid = get_uid();
            sprintf(buf, "%08" PRIx64, uid);
            publish("requestPool", buf);
            gpio_pin_set(gpio_dev, GREEN_LED_PIN, LED_ON);
        }
    }
    k_delayed_work_submit(&send_measure_work, K_MSEC(10000 + randint(0, 1000)));
    gpio_pin_set(gpio_dev, BLUE_LED_PIN, LED_OFF);
}
void init_leds(void)
{
    gpio_pin_configure(gpio_dev, RED_LED_PIN, GPIO_OUTPUT_HIGH);
    gpio_pin_configure(gpio_dev, GREEN_LED_PIN, GPIO_OUTPUT_HIGH);
    gpio_pin_configure(gpio_dev, BLUE_LED_PIN, GPIO_OUTPUT_HIGH);
}
void button_pressed_callback(const struct device *gpiob, struct gpio_callback *cb, gpio_port_pins_t pins)
{
    button_pressed = true;
}
bool init_button(void)
{
    int ret = gpio_pin_configure(gpio_dev, BUTTON_GPIO_PIN, BUTTON_GPIO_FLAGS);
    if (ret != 0)
    {
        printk("Error %d: failed to configure %s pin %d\n",
               ret, BUTTON_GPIO_LABEL, BUTTON_GPIO_PIN);

        return false;
    }

    ret = gpio_pin_interrupt_configure(gpio_dev,
                                       BUTTON_GPIO_PIN,
                                       GPIO_INT_EDGE_TO_ACTIVE);
    if (ret != 0)
    {
        printk("Error %d: failed to configure interrupt on %s pin %d\n",
               ret, BUTTON_GPIO_LABEL, BUTTON_GPIO_PIN);

        return false;
    }

    gpio_init_callback(&gpio_cb, button_pressed_callback, BIT(BUTTON_GPIO_PIN));
    gpio_add_callback(gpio_dev, &gpio_cb);

    return true;
}

void main(void)
{
    gpio_dev = device_get_binding(DT_LABEL(DT_NODELABEL(gpio0)));

    if (!gpio_dev)
    {
        LOG_ERR("Error getting GPIO device binding\r");
    }
    if (!init_button())
    {
        LOG_ERR("failed to init button");
    }
    init_leds();
    gpio_pin_set(gpio_dev, RED_LED_PIN, LED_ON);
    gpio_pin_set(gpio_dev, GREEN_LED_PIN, LED_ON);
    gpio_pin_set(gpio_dev, BLUE_LED_PIN, LED_OFF);

    struct aws_iot_config iot_config;
    int err;

    LOG_WRN("MSE TM Privacy impl demo started, version: %s", CONFIG_APP_VERSION);

    cJSON_Init();

#if defined(CONFIG_BSD_LIBRARY)
    err = bsdlib_init();
    at_configure();
#endif
    err = aws_iot_init(&iot_config, aws_iot_event_handler);
    if (err)
    {
        LOG_ERR("AWS IoT library could not be initialized, error: %d",
                err);
    }

    /** Subscribe to customizable non-shadow specific topics
 *  to AWS IoT backend.
 */

    work_init();

    k_delayed_work_init(&send_measure_work, send_measure);
#if defined(CONFIG_BSD_LIBRARY)
    err = modem_info_init();
    if (err)
    {
        LOG_ERR("Failed initializing modem info module, error: %d",
                err);
    }
    modem_configure();

    k_sem_take(&lte_connected, K_FOREVER);
#endif

    date_time_update_async(date_time_event_handler);

    err = k_sem_take(&date_time_obtained, K_SECONDS(DATE_TIME_TIMEOUT_S));
    if (err)
    {
        LOG_ERR("Date time, no callback event within %d seconds",
                DATE_TIME_TIMEOUT_S);
    }

    err = aws_iot_connect(&iot_config);
    if (err)
    {
        LOG_ERR("aws_iot_connect failed: %d", err);
    }
    err = app_topics_subscribe();
    if (err)
    {
        LOG_ERR("Adding application specific topics failed, error: %d",
                err);
    }
    //k_delayed_work_submit(&send_measure_work, K_MSEC(5000));
    gpio_pin_set(gpio_dev, RED_LED_PIN, LED_OFF);
    gpio_pin_set(gpio_dev, GREEN_LED_PIN, LED_OFF);
    while (1)
    {
        k_sleep(K_MSEC(10));
        if (button_pressed)
        {
            button_pressed = false;
            uint8_t buf[64];
            uint64_t uid = get_uid();
            sprintf(buf, "%08" PRIx64, uid);
            publish("requestPool", buf);
        }
    }
}
```

## src/custom_secure.h
```c
#ifndef CUSTOM_SECURE_H__
#define CUSTOM_SECURE_H__

#include <stdint.h>

int spm_store_key_in_kmu(uint32_t slot_id, uint32_t addr, uint32_t permission, uint8_t *key);

int spm_encrypt_using_keyslot(uint8_t slot_id, uint32_t keybits, uint8_t *plaintext, uint8_t *encrypted);

int spm_decrypt_using_keyslot(uint8_t slot_id, uint32_t keybits, uint8_t *encrypted, uint8_t *plaintext);

#endif
```

## src/measures.c
```c
#include "measures.h"

LOG_MODULE_REGISTER(measures, LOG_LEVEL_DBG);

void swap(measure_t *a, measure_t *b)
{
    measure_t tmp;
    memcpy(&tmp, a, sizeof(measure_t));
    memcpy(a, b, sizeof(measure_t));
    memcpy(b, &tmp, sizeof(measure_t));
}

void shuffle(measure_t *m, uint32_t n)
{
    for (int i = 0; i < n; i++)
    {
        int j = randint(0, n);
        swap(&m[i], &m[j]);
    }
}

int encrypt(uint8_t *plainIn, uint8_t *encryptedOut, size_t len)
{
    int ret = 0;
    for (int i = 0; i < len / 16; i++)
    {
        ret += spm_encrypt_using_keyslot(KEYSLOT_SF, SF_BIT_LENGTH, &plainIn[i * 16], &encryptedOut[i * 16]);
    }
    return ret;
}

int decrypt(uint8_t *encryptedIn, uint8_t *plainOut, size_t len)
{
    int ret = 0;
    for (int i = 0; i < len / 16; i++)
    {
        ret += spm_decrypt_using_keyslot(KEYSLOT_SF, SF_BIT_LENGTH, &encryptedIn[i * 16], &plainOut[i * 16]);
    }
    return ret;
}

size_t pack(uint8_t *buf, measure_t *m)
{
    uint32_t index = 0;

    memcpy(buf + index, m->MUID, 32 * sizeof(m->MUID[0]));
    index += 32 * sizeof(m->MUID[0]);
    memcpy(buf + index, &m->timestamp, sizeof(m->timestamp));
    index += sizeof(m->timestamp);
    memcpy(buf + index, m->position, 2 * sizeof(m->position[0]));
    index += 2 * sizeof(m->position[0]);
    memcpy(buf + index, &m->data, sizeof(m->data));
    index += sizeof(m->data);
    memcpy(buf + index, &m->reliability, sizeof(m->reliability));
    index += sizeof(m->reliability);
    return index;
}
size_t unpack(uint8_t *buf, measure_t *m)
{
    uint32_t index = 0;

    memcpy(m->MUID, buf + index, 32 * sizeof(m->MUID[0]));
    index += 32 * sizeof(m->MUID[0]);
    memcpy(&m->timestamp, buf + index, sizeof(m->timestamp));
    index += sizeof(m->timestamp);
    memcpy(m->position, buf + index, 2 * sizeof(m->position[0]));
    index += 2 * sizeof(m->position[0]);
    memcpy(&m->data, buf + index, sizeof(m->data));
    index += sizeof(m->data);
    memcpy(&m->reliability, buf + index, sizeof(m->reliability));
    index += sizeof(m->reliability);
    return index;
}

int GenerateMUID(measure_t *m, uint64_t uid)
{

    // get random number from TRNG
    // should not be an array, only one, but currently the TRNG only accepts a 144-len request
    uint64_t rand[18];
    size_t oLen = 0;
    spm_request_random_number((uint8_t *)rand, sizeof(rand), &oLen);

    // concatenate data
    uint8_t _buf[512];
    sprintf(_buf, "%" PRId64 "%" PRId64 "%" PRIx64, uid, m->timestamp, rand[0]);

    //LOG_DBG("MUID unhashed: %s", _buf);
    // hash string to get MUID
    mbedtls_md_context_t ctx;
    mbedtls_md_type_t md_type = MBEDTLS_MD_SHA256;
    const size_t payloadLength = strlen(_buf);
    mbedtls_md_init(&ctx);
    mbedtls_md_setup(&ctx, mbedtls_md_info_from_type(md_type), 0);
    mbedtls_md_starts(&ctx);
    mbedtls_md_update(&ctx, (const unsigned char *)_buf, payloadLength);
    mbedtls_md_finish(&ctx, m->MUID);
    mbedtls_md_free(&ctx);

    // HEPIA coordinates
    m->position[0] = 0;
    m->position[1] = 0;

    // datetime

    int ret = date_time_now(&m->timestamp);
    if (ret)
    {
        LOG_ERR("failed to get UTC time: %d", ret);
    }

    // since temp is from modem
    m->reliability = 1.0;
    return 0;
}

void printMeasure(measure_t *m)
{
    LOG_INF("MUID: 0x");
    for (int i = 0; i < 32; i++)
    {
        printk("%02X", m->MUID[i]);
    }
    printk("");
    LOG_INF("%" PRIX64 "", m->timestamp);
    LOG_INF("%" PRIx64 ", %" PRIx64 "", m->position[0], m->position[1]);
    LOG_INF("%" PRId64 "", m->data);
    LOG_INF("%" PRIx64 "", m->reliability);
}

void printMUID(measure_t *m)
{
    char buf[64];
    for (int i = 0; i < 32; i++)
    {
        sprintf(&buf[i * 2], "%02X", m->MUID[i]);
        //printk("%02X", m->MUID[i]);
    }
    LOG_INF("MUID: 0x%s", buf);
}

char *measure_as_json(measure_t *measure)
{
    cJSON *clear = cJSON_CreateObject();
    if (clear == NULL)
    {
        LOG_ERR("failed to allocate memory for measure json");
    }
    char MUIDstr[65];
    for (int x = 0; x < 32; x++)
    {
        sprintf(&MUIDstr[x * 2], "%02X", measure->MUID[x]);
    }
    cJSON_AddStringToObject(clear, "MUID", MUIDstr);
    cJSON_AddNumberToObject(clear, "timestamp", measure->timestamp);
    cJSON *positions = cJSON_AddArrayToObject(clear, "position");
    cJSON_AddItemToArray(positions, cJSON_CreateNumber(measure->position[0]));
    cJSON_AddItemToArray(positions, cJSON_CreateNumber(measure->position[1]));
    cJSON_AddNumberToObject(clear, "data", measure->data);
    cJSON_AddNumberToObject(clear, "reliability", measure->reliability);
    char *message = cJSON_PrintUnformatted(clear);
    cJSON_Delete(clear);
    return message;
}
```

## src/measures.h
```c
#ifndef MEASURES_H__
#define MEASURES_H__

#include <stdio.h>
#include <stdlib.h>
#include <logging/log.h>
#include <secure_services.h>
#include <sha256.h>
#include <mbedtls/md.h>
#include "custom_secure.h"
#include <date_time.h>
#include <cJSON.h>
#include <cJSON_os.h>

#define KEYSLOT_SF 2
#define SF_BIT_LENGTH 128

typedef struct
{
    uint8_t MUID[32];
    uint64_t timestamp;
    double position[2];
    uint64_t data;
    float reliability;

} measure_t;

void swap(measure_t *a, measure_t *b);
void shuffle(measure_t *m, uint32_t n);
int encrypt(uint8_t *plainIn, uint8_t *encryptedOut, size_t len);
int decrypt(uint8_t *encryptedIn, uint8_t *plainOut, size_t len);
size_t pack(uint8_t *buf, measure_t *m);
size_t unpack(uint8_t *buf, measure_t *m);
int GenerateMUID(measure_t *m, uint64_t uid);
void printMeasure(measure_t *m);
void printMUID(measure_t *m);
char *measure_as_json(measure_t *measure);

#endif
```

## src/secure_services_ns.c
```c
#include <autoconf.h>
#include <secure_services.h>
#include <toolchain.h>
#include <fw_info.h>

/*#define NRF_NSE(ret, name, ...)  \
    ret name##_nse(__VA_ARGS__); \
    TZ_THREAD_SAFE_NONSECURE_ENTRY_FUNC(name, ret, name##_nse, __VA_ARGS__)
*/

NRF_NSE(int, spm_store_key_in_kmu, uint32_t slot_id, uint32_t addr, uint32_t permission, uint8_t *key);

NRF_NSE(int, spm_encrypt_using_keyslot, uint8_t slot_id, uint32_t keybits, uint8_t *plaintext, uint8_t *encrypted);

NRF_NSE(int, spm_decrypt_using_keyslot, uint8_t slot_id, uint32_t keybits, uint8_t *encrypted, uint8_t *plaintext);

/*
int spm_store_key_in_kmu(uint32_t slot_id, uint32_t addr, uint32_t permission, uint8_t *key);

int spm_encrypt_using_keyslot(uint8_t slot_id, uint32_t keybits, uint8_t *plaintext, uint8_t *encrypted);

int spm_decrypt_using_keyslot(uint8_t slot_id, uint32_t keybits, uint8_t *encrypted, uint8_t *plaintext);
*/
```
